## config/boards/shields/DRTKB/Kconfig.defconfig
```kconfig
if SHIELD_DRTKB_LEFT
config ZMK_KEYBOARD_NAME
    default "DRTKB"
config ZMK_SPLIT_ROLE_CENTRAL
    default y

endif
if SHIELD_DRTKB_LEFT || SHIELD_DRTKB_RIGHT
config ZMK_SPLIT
	default y
endif
```

## config/boards/shields/DRTKB/Kconfig.shield
```kconfig
config SHIELD_DRTKB_LEFT
    def_bool $(shields_list_contains, DRTKB_left)

config SHIELD_DRTKB_RIGHT
    def_bool $(shields_list_contains, DRTKB_right)
```
